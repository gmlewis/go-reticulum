## firmware/esp32c5-grb/sdkconfig.defaults
```kconfig
# Target Configuration for ESP32-C5 RISC-V SoC
CONFIG_IDF_TARGET="esp32c5"
CONFIG_IDF_TARGET_ESP32C5=y
CONFIG_IDF_TARGET_ESP32C5_BETA3_VERSION=y

# High performance 240 MHz CPU frequency
CONFIG_ESP_DEFAULT_CPU_FREQ_MHZ_240=y

# Wi-Fi 6 & SoftAP configuration
CONFIG_ESP_WIFI_ENABLED=y
CONFIG_ESP_WIFI_SOFTAP_SUPPORT=y
CONFIG_ESP_WIFI_STA_DISCONNECTED_PM_ENABLE=n
CONFIG_ESP_WIFI_STATIC_RX_BUFFER_NUM=10
CONFIG_ESP_WIFI_DYNAMIC_RX_BUFFER_NUM=32
CONFIG_ESP_WIFI_DYNAMIC_TX_BUFFER_NUM=32

# Logging & Monitoring
CONFIG_LOG_DEFAULT_LEVEL_INFO=y

# Stack and Memory
CONFIG_ESP_MAIN_TASK_STACK_SIZE=8192
```
